## firmware/main/Kconfig.projbuild
```kconfig
menu "Wavehound"

    config WH_UART_TX_GPIO
        int "UART TX GPIO (to Flipper pin 14 / RX)"
        default 43

    config WH_UART_RX_GPIO
        int "UART RX GPIO (from Flipper pin 13 / TX)"
        default 44

    config WH_UART_BAUD
        int "UART baud rate"
        default 115200

    config WH_MAX_CHANNEL
        int "Highest 2.4 GHz channel to use"
        range 11 13
        default 13
        help
            Use 11 in regions where channels 12/13 are not allowed.

    config WH_LED_ENABLE
        bool "Drive the on-board RGB LED"
        default y

    config WH_LED_R_GPIO
        int "LED red GPIO"
        depends on WH_LED_ENABLE
        default 6

    config WH_LED_G_GPIO
        int "LED green GPIO"
        depends on WH_LED_ENABLE
        default 5

    config WH_LED_B_GPIO
        int "LED blue GPIO"
        depends on WH_LED_ENABLE
        default 4

    config WH_LED_ACTIVE_LOW
        bool "LED is active low"
        depends on WH_LED_ENABLE
        default y

endmenu
```
